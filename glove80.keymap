/*
 * Copyright (c) 2020 The ZMK Contributors
 * Copyright (c) 2025 Innaworks Development Limited, trading as MoErgo
 *
 * SPDX-License-Identifier: MIT
 */


/* THIS FILE WAS GENERATED BY GLOVE80 LAYOUT EDITOR
 *
 * This file was generated automatically. You may or may not want to
 * edit it directly.
 */

#include <behaviors.dtsi>
/* Include all behavior includes needed */
#include <dt-bindings/zmk/outputs.h>
#include <dt-bindings/zmk/keys.h>
#include <dt-bindings/zmk/bt.h>
#include <dt-bindings/zmk/rgb.h>

/* On demand includes */
#include <dt-bindings/zmk/input_transform.h>
#include <dt-bindings/zmk/pointing.h>
#include <input/processors.dtsi>

/* Helper Macros, based on https://github.com/urob/zmk-helpers/ */

#pragma once

#define ZMK_HELPER_STRINGIFY(x) #x

// Preprocessor mechanism to overload macros, cf. https://stackoverflow.com/a/27051616/6114651
#define VARGS_(_10, _9, _8, _7, _6, _5, _4, _3, _2, _1, N, ...) N
#define VARGS(...) VARGS_(__VA_ARGS__, 10, 9, 8, 7, 6, 5, 4, 3, 2, 1, 0)
#define CONCAT_(a, b) a##b
#define CONCAT(a, b) CONCAT_(a, b)

#define ZMK_BEHAVIOR_CORE_tap_dance  \
    compatible = "zmk,behavior-tap-dance"; \
    #binding-cells = <0>

#define ZMK_BEHAVIOR(name, type, ...) \
    name: name { \
        ZMK_BEHAVIOR_CORE_ ## type; \
        __VA_ARGS__ \
    };

#define ZMK_TAP_DANCE(name, ...) \
    ZMK_BEHAVIOR(name, tap_dance, __VA_ARGS__)

#define ZMK_TD_LAYER(name, layer) \
    ZMK_TAP_DANCE(name, \
        tapping-term-ms = <200>; \
        bindings = <&mo layer>, <&to layer>; \
)

/* Automatically generated layer name #define */
#define LAYER_Base 0
#define LAYER_Nav 1
#define LAYER_Symbol 2
#define LAYER_Shortcut 3
#define LAYER_Mouse 4
#define LAYER_Magic 5
#define LAYER_Num 6
#define LAYER_Gaming 7
#define LAYER_Mirror 8
#define LAYER_Mouse_fast 9
#define LAYER_Mouse_warp 10
#define LAYER_Nav_enter 11

/* To deal with the situation where there is no Lower layer, to keep &lower happy */
#ifndef LAYER_Lower
#define LAYER_Lower 0
#endif

/* Custom Device-tree */
/ {
    underglow-layer {
        compatible  = "zmk,underglow-layer";

        // color definitions from QMK
        // https://github.com/qmk/qmk_firmware/blob/master/quantum/color.h
        //
        #define RGB_AZURE     0x99F5FF // #99F5FF
        #define RGB_BLACK     0x000000 // #000000
        #define RGB_BLUE      0x0000FF // #0000FF
        #define RGB_CHARTRSE  0x80FF00 // #80FF00
        #define RGB_CORAL     0xFF7C4D // #FF7C4D
        #define RGB_CYAN      0x00FFFF // #00FFFF
        #define RGB_GOLD      0xFFD900 // #FFD900
        #define RGB_GOLDNROD  0xD9A521 // #D9A521
        #define RGB_GREEN     0x00FF00 // #00FF00
        #define RGB_MAGENTA   0xFF00FF // #FF00FF
        #define RGB_ORANGE    0xFF8000 // #FF8000
        #define RGB_PINK      0xFF80BF // #FF80BF
        #define RGB_PURPLE    0x7A00FF // #7A00FF
        #define RGB_RED       0xFF0000 // #FF0000
        #define RGB_SPRINGRN  0x00FF80 // #00FF80
        #define RGB_TEAL      0x008080 // #008080
        #define RGB_TURQUOIS  0x476E6A // #476E6A
        #define RGB_WHITE     0xFFFFFF // #FFFFFF
        #define RGB_YELLOW    0xFFFF00 // #FFFF00

        // underglow for the colors above
        //
        #define AZURE     &ug RGB_AZURE
        #define BLACK     &ug RGB_BLACK
        #define BLUE      &ug RGB_BLUE
        #define CHARTRSE  &ug RGB_CHARTRSE
        #define CORAL     &ug RGB_CORAL
        #define CYAN      &ug RGB_CYAN
        #define GOLD      &ug RGB_GOLD
        #define GOLDNROD  &ug RGB_GOLDNROD
        #define GREEN     &ug RGB_GREEN
        #define MAGENTA   &ug RGB_MAGENTA
        #define ORANGE    &ug RGB_ORANGE
        #define PINK      &ug RGB_PINK
        #define PURPLE    &ug RGB_PURPLE
        #define RED       &ug RGB_RED
        #define SPRINGRN  &ug RGB_SPRINGRN
        #define TEAL      &ug RGB_TEAL
        #define TURQUOIS  &ug RGB_TURQUOIS
        #define WHITE     &ug RGB_WHITE
        #define YELLOW    &ug RGB_YELLOW
        #define ________  &ug RGB_BLACK

        /*
        Template {
            bindings = <
                ________ ________ ________ ________ ________                                                                          ________ ________ ________ ________ ________
                ________ ________ ________ ________ ________ ________                                                        ________ ________ ________ ________ ________ ________
                ________ ________ ________ ________ ________ ________                                                        ________ ________ ________ ________ ________ ________
                ________ ________ ________ ________ ________ ________                                                        ________ ________ ________ ________ ________ ________
                ________ ________ ________ ________ ________ ________ ________ ________ ________  ________ ________ ________ ________ ________ ________ ________ ________ ________
                ________ ________ ________ ________ ________          ________ ________ ________  ________ ________ ________          ________ ________ ________ ________ ________
        >;
            layer-id = <LAYER_Template>;
        };
        */
        nav {
            bindings = <
                ________ ________ ________ ________ ________                                                                          ________ ________ ________ ________ ________
                ________ ________ ________ ________ ________ GREEN                                                           ________ ________ ________ ________ ________ ________
                ________ ________ ________ ________ ________ ________                                                        ________ ________ ________ ________ ________ ________
                ________ ________ ________ ________ ________ ________                                                        ________ ________ ________ ________ ________ ________
                ________ ________ ________ ________ ________ ________ ________ ________ ________  ________ ________ ________ ________ ________ ________ ________ ________ ________
                ________ ________ ________ ________ ________          ________ ________ ________  ________ ________ ________          ________ ________ ________ ________ ________
        >;
            layer-id = <LAYER_Nav>;
        };

        nav_enter {
            bindings = <
                ________ ________ ________ ________ ________                                                                          ________ ________ ________ ________ ________
                ________ ________ ________ ________ RED      GREEN                                                           ________ ________ ________ ________ ________ ________
                ________ ________ ________ ________ ________ ________                                                        ________ ________ ________ ________ ________ ________
                ________ ________ ________ ________ ________ ________                                                        ________ ________ ________ ________ ________ ________
                ________ ________ ________ ________ ________ ________ ________ ________ ________  ________ ________ ________ ________ ________ ________ ________ ________ ________
                ________ ________ ________ ________ ________          ________ ________ ________  ________ ________ ________          ________ ________ ________ ________ ________
        >;
            layer-id = <LAYER_Nav_enter>;
        };

        symbol {
            bindings = <
                ________ ________ ________ ________ ________                                                                          ________ ________ ________ ________ ________
                ________ ________ ________ ________ ________ PINK                                                            ________ ________ ________ ________ ________ ________
                ________ ________ ________ ________ ________ ________                                                        ________ ________ ________ ________ ________ ________
                ________ ________ ________ ________ ________ ________                                                        ________ ________ ________ ________ ________ ________
                ________ ________ ________ ________ ________ ________ ________ ________ ________  ________ ________ ________ ________ ________ ________ ________ ________ ________
                ________ ________ ________ ________ ________          ________ ________ ________  ________ ________ ________          ________ ________ ________ ________ ________
        >;
            layer-id = <LAYER_Symbol>;
        };

        shortcut {
            bindings = <
                ________ ________ ________ ________ ________                                                                          ________ ________ ________ ________ ________
                ________ ________ ________ ________ ________ ORANGE                                                          ________ ________ ________ ________ ________ ________
                ________ ________ ________ ________ ________ ________                                                        ________ ________ ________ ________ ________ ________
                ________ ________ ________ ________ ________ ________                                                        ________ ________ ________ ________ ________ ________
                ________ ________ ________ ________ ________ ________ ________ ________ ________  ________ ________ ________ ________ ________ ________ ________ ________ ________
                ________ ________ ________ ________ ________          ________ ________ ________  ________ ________ ________          ________ ________ ________ ________ ________
        >;
            layer-id = <LAYER_Shortcut>;
        };

        mouse {
            bindings = <
                ________ ________ ________ ________ ________                                                                          ________ ________ ________ ________ ________
                ________ ________ ________ ________ ________ YELLOW                                                          ________ ________ ________ ________ ________ ________
                ________ ________ ________ ________ ________ ________                                                        ________ ________ ________ ________ ________ ________
                ________ ________ ________ ________ ________ ________                                                        ________ ________ ________ ________ ________ ________
                ________ ________ ________ ________ ________ ________ ________ ________ ________  ________ ________ ________ ________ ________ ________ ________ ________ ________
                ________ ________ ________ ________ ________          ________ ________ ________  ________ ________ ________          ________ ________ ________ ________ ________
        >;
            layer-id = <LAYER_Mouse>;
        };

        mouse_fast {
            bindings = <
                ________ ________ ________ ________ ________                                                                          ________ ________ ________ ________ ________
                ________ ________ ________ ________ ________ YELLOW                                                          ________ ________ ________ ________ ________ ________
                ________ ________ ________ ________ ________ ________                                                        ________ ________ ________ ________ ________ ________
                ________ ________ ________ ________ ________ ________                                                        ________ ________ ________ ________ ________ ________
                ________ ________ ________ ________ ________ ________ ________ ________ ________  ________ ________ ________ ________ ________ ________ ________ ________ ________
                ________ ________ ________ ________ ________          ________ ________ ________  ________ ________ ________          ________ ________ ________ ________ ________
        >;
            layer-id = <LAYER_Mouse_fast>;
        };


        mouse_warp {
            bindings = <
                ________ ________ ________ ________ ________                                                                          ________ ________ ________ ________ ________
                ________ ________ ________ ________ ________ YELLOW                                                          ________ ________ ________ ________ ________ ________
                ________ ________ ________ ________ ________ ________                                                        ________ ________ ________ ________ ________ ________
                ________ ________ ________ ________ ________ ________                                                        ________ ________ ________ ________ ________ ________
                ________ ________ ________ ________ ________ ________ ________ ________ ________  ________ ________ ________ ________ ________ ________ ________ ________ ________
                ________ ________ ________ ________ ________          ________ ________ ________  ________ ________ ________          ________ ________ ________ ________ ________
        >;
            layer-id = <LAYER_Mouse_warp>;
        };

        magic {
            bindings = <
                ________ ________ ________ ________ ________                                                                          ________ ________ ________ ________ ________
                ________ ________ ________ ________ ________ MAGENTA                                                         ________ ________ ________ ________ ________ ________
                ________ ________ ________ ________ ________ ________                                                        ________ ________ ________ ________ ________ ________
                RED      ________ ________ ________ ________ ________                                                        ________ ________ ________ ________ ________ RED
                ________ ________ ________ ________ ________ ________ ________ ________ ________  ________ ________ ________ ________ ________ ________ ________ ________ ________
                ________ ________ ________ ________ ________          ________ ________ ________  ________ ________ ________          ________ ________ ________ ________ ________
        >;
            layer-id = <LAYER_Magic>;
        };


        num {
            bindings = <
                ________ ________ ________ ________ ________                                                                          ________ ________ ________ ________ ________
                ________ ________ ________ ________ ________ CYAN                                                            ________ ________ ________ ________ ________ ________
                ________ ________ ________ ________ ________ ________                                                        ________ ________ ________ ________ ________ ________
                ________ ________ ________ ________ ________ ________                                                        ________ ________ ________ ________ ________ ________
                ________ ________ ________ ________ ________ ________ ________ ________ ________  ________ ________ ________ ________ ________ ________ ________ ________ ________
                ________ ________ ________ ________ ________          ________ ________ ________  ________ ________ ________          ________ ________ ________ ________ ________
        >;
            layer-id = <LAYER_Num>;
        };

        gaming {
            bindings = <
                ________ ________ ________ ________ ________                                                                          ________ ________ ________ ________ ________
                ________ ________ ________ ________ ________ RED                                                             ________ ________ ________ ________ ________ ________
                ________ ________ ________ ________ ________ ________                                                        ________ ________ ________ ________ ________ ________
                ________ ________ ________ ________ ________ ________                                                        ________ ________ ________ ________ ________ ________
                ________ ________ ________ ________ ________ ________ ________ ________ ________  ________ ________ ________ ________ ________ ________ ________ ________ ________
                ________ ________ ________ ________ ________          ________ ________ ________  ________ ________ ________          ________ ________ ________ ________ ________
        >;
            layer-id = <LAYER_Gaming>;
        };

        mirror {
            bindings = <
                ________ ________ ________ ________ ________                                                                          ________ ________ ________ ________ ________
                ________ ________ ________ ________ ________ WHITE                                                           ________ ________ ________ ________ ________ ________
                ________ ________ ________ ________ ________ ________                                                        ________ ________ ________ ________ ________ ________
                ________ ________ ________ ________ ________ ________                                                        ________ ________ ________ ________ ________ ________
                ________ ________ ________ ________ ________ ________ ________ ________ ________  ________ ________ ________ ________ ________ ________ ________ ________ ________
                ________ ________ ________ ________ ________          ________ ________ ________  ________ ________ ________          ________ ________ ________ ________ ________
        >;
            layer-id = <LAYER_Mirror>;
        };
    };
};

/* Input Listeners */
&mmv_input_listener {
    Mouse_fast {
        layers = <9>;
        input-processors = <&zip_xy_scaler 3 1>;
    };
    Mouse_warp {
        layers = <10>;
        input-processors = <&zip_xy_scaler 12 1>;
    };
};

&msc_input_listener {
    Mouse_fast {
        layers = <9>;
        input-processors = <&zip_scroll_scaler 3 1>;
    };
    Mouse_warp {
        layers = <10>;
        input-processors = <&zip_scroll_scaler 12 1>;
    };
};

/* System behavior and Macros */
/ {
    behaviors {
        ZMK_TD_LAYER(lower, LAYER_Lower)
    };
};

/ {
    macros {
        rgb_ug_status_macro: rgb_ug_status_macro {
            label = "RGB_UG_STATUS";
            compatible = "zmk,behavior-macro";
            #binding-cells = <0>;
            bindings
                = <&rgb_ug RGB_STATUS>;
        };
    };
};


/ {
#ifdef BT_DISC_CMD
    behaviors {
        bt_0: bt_0 {
            compatible = "zmk,behavior-tap-dance";
            label = "BT_0";
            #binding-cells = <0>;
            tapping-term-ms = <200>;
            bindings = <&bt_select_0>, <&bt BT_DISC 0>;
        };
        bt_1: bt_1 {
            compatible = "zmk,behavior-tap-dance";
            label = "BT_1";
            #binding-cells = <0>;
            tapping-term-ms = <200>;
            bindings = <&bt_select_1>, <&bt BT_DISC 1>;
        };
        bt_2: bt_2 {
            compatible = "zmk,behavior-tap-dance";
            label = "BT_2";
            #binding-cells = <0>;
            tapping-term-ms = <200>;
            bindings = <&bt_select_2>, <&bt BT_DISC 2>;
        };
        bt_3: bt_3 {
            compatible = "zmk,behavior-tap-dance";
            label = "BT_3";
            #binding-cells = <0>;
            tapping-term-ms = <200>;
            bindings = <&bt_select_3>, <&bt BT_DISC 3>;
        };
    };
    macros {
        bt_select_0: bt_select_0 {
            label = "BT_SELECT_0";
            compatible = "zmk,behavior-macro";
            #binding-cells = <0>;
            bindings
                = <&out OUT_BLE>,
                  <&bt BT_SEL 0>;
        };
        bt_select_1: bt_select_1 {
            label = "BT_SELECT_1";
            compatible = "zmk,behavior-macro";
            #binding-cells = <0>;
            bindings
                = <&out OUT_BLE>,
                  <&bt BT_SEL 1>;
        };
        bt_select_2: bt_select_2 {
            label = "BT_SELECT_2";
            compatible = "zmk,behavior-macro";
            #binding-cells = <0>;
            bindings
                = <&out OUT_BLE>,
                  <&bt BT_SEL 2>;
        };
        bt_select_3: bt_select_3 {
            label = "BT_SELECT_3";
            compatible = "zmk,behavior-macro";
            #binding-cells = <0>;
            bindings
                = <&out OUT_BLE>,
                  <&bt BT_SEL 3>;
        };
    };
#else
    macros {
        bt_0: bt_0 {
            label = "BT_0";
            compatible = "zmk,behavior-macro";
            #binding-cells = <0>;
            bindings
                = <&out OUT_BLE>,
                  <&bt BT_SEL 0>;
        };
        bt_1: bt_1 {
            label = "BT_1";
            compatible = "zmk,behavior-macro";
            #binding-cells = <0>;
            bindings
                = <&out OUT_BLE>,
                  <&bt BT_SEL 1>;
        };
        bt_2: bt_2 {
            label = "BT_2";
            compatible = "zmk,behavior-macro";
            #binding-cells = <0>;
            bindings
                = <&out OUT_BLE>,
                  <&bt BT_SEL 2>;
        };
        bt_3: bt_3 {
            label = "BT_3";
            compatible = "zmk,behavior-macro";
            #binding-cells = <0>;
            bindings
                = <&out OUT_BLE>,
                  <&bt BT_SEL 3>;
        };
    };
#endif
};

/ {
    behaviors {
        magic: magic {
            compatible = "zmk,behavior-hold-tap";
            label = "MAGIC_HOLD_TAP";
            #binding-cells = <2>;
            flavor = "tap-preferred";
            tapping-term-ms = <200>;
            bindings = <&mo>, <&rgb_ug_status_macro>;
        };
    };
};

/* #define for key positions */
#define POS_LH_T1 52
#define POS_LH_T2 53
#define POS_LH_T3 54
#define POS_LH_T4 69
#define POS_LH_T5 70
#define POS_LH_T6 71
#define POS_LH_C1R2 15
#define POS_LH_C1R3 27
#define POS_LH_C1R4 39
#define POS_LH_C1R5 51
#define POS_LH_C2R1 4
#define POS_LH_C2R2 14
#define POS_LH_C2R3 26
#define POS_LH_C2R4 38
#define POS_LH_C2R5 50
#define POS_LH_C2R6 68
#define POS_LH_C3R1 3
#define POS_LH_C3R2 13
#define POS_LH_C3R3 25
#define POS_LH_C3R4 37
#define POS_LH_C3R5 49
#define POS_LH_C3R6 67
#define POS_LH_C4R1 2
#define POS_LH_C4R2 12
#define POS_LH_C4R3 24
#define POS_LH_C4R4 36
#define POS_LH_C4R5 48
#define POS_LH_C4R6 66
#define POS_LH_C5R1 1
#define POS_LH_C5R2 11
#define POS_LH_C5R3 23
#define POS_LH_C5R4 35
#define POS_LH_C5R5 47
#define POS_LH_C5R6 65
#define POS_LH_C6R1 0
#define POS_LH_C6R2 10
#define POS_LH_C6R3 22
#define POS_LH_C6R4 34
#define POS_LH_C6R5 46
#define POS_LH_C6R6 64
#define POS_RH_T1 57
#define POS_RH_T2 56
#define POS_RH_T3 55
#define POS_RH_T4 74
#define POS_RH_T5 73
#define POS_RH_T6 72
#define POS_RH_C1R2 16
#define POS_RH_C1R3 28
#define POS_RH_C1R4 40
#define POS_RH_C1R5 58
#define POS_RH_C2R1 5
#define POS_RH_C2R2 17
#define POS_RH_C2R3 29
#define POS_RH_C2R4 41
#define POS_RH_C2R5 59
#define POS_RH_C2R6 75
#define POS_RH_C3R1 6
#define POS_RH_C3R2 18
#define POS_RH_C3R3 30
#define POS_RH_C3R4 42
#define POS_RH_C3R5 60
#define POS_RH_C3R6 76
#define POS_RH_C4R1 7
#define POS_RH_C4R2 19
#define POS_RH_C4R3 31
#define POS_RH_C4R4 43
#define POS_RH_C4R5 61
#define POS_RH_C4R6 77
#define POS_RH_C5R1 8
#define POS_RH_C5R2 20
#define POS_RH_C5R3 32
#define POS_RH_C5R4 44
#define POS_RH_C5R5 62
#define POS_RH_C5R6 78
#define POS_RH_C6R1 9
#define POS_RH_C6R2 21
#define POS_RH_C6R3 33
#define POS_RH_C6R4 45
#define POS_RH_C6R5 63
#define POS_RH_C6R6 79

/* Custom Defined Behaviors */
/ {
#include <dt-bindings/zmk/behaviors.h>

behaviors {
        mt: mod_tap {
            compatible = "zmk,behavior-hold-tap";
            #binding-cells = <2>;
            flavor = "tap-preferred";
            tapping-term-ms = <250>;
            require-prior-idle-ms = <125>;
            bindings = <&kp>, <&kp>;
            display-name = "Mod-Tap";
        };

        mo_tog: behavior_mo_tog {
            compatible = "zmk,behavior-hold-tap";
            #binding-cells = <2>;
            flavor = "hold-preferred";
            tapping-term-ms = <200>;
            bindings = <&mo>, <&tog>;
        };

        mt_hold_pref: mod_tap_prefer_hold {
            compatible = "zmk,behavior-hold-tap";
            #binding-cells = <2>;
            flavor = "hold-preferred";
            tapping-term-ms = <200>;
            quick-tap-ms = <175>;
            bindings = <&kp>, <&kp>;
            display-name = "Mod-Tap Hold pref";
        };

        lt_hold_pref: layer_tap_prefer_hold {
            compatible = "zmk,behavior-hold-tap";
            #binding-cells = <2>;
            flavor = "hold-preferred";
            tapping-term-ms = <200>;
            quick-tap-ms = <175>;
            bindings = <&mo>, <&kp>;
            display-name = "Layer-Tap Hold pref";
        };
    };
};

/* Automatically generated macro definitions */
/ {
    macros {

        // Ctrl+End, Home
        CEND_HOME: CEND_HOME {
            label = "&CEND_HOME";
            compatible = "zmk,behavior-macro";
            #binding-cells = <0>;
            bindings = <&kp LC(END)>
                , <&kp HOME>;
        };

        // ` CMS
        BACKTICK: BACKTICK {
            label = "&BACKTICK";
            compatible = "zmk,behavior-macro";
            #binding-cells = <0>;
            bindings = <&kp RA(LBKT)>
                , <&kp SPACE>;
        };

        // -> CMS
        ARROW: ARROW {
            label = "&ARROW";
            compatible = "zmk,behavior-macro";
            #binding-cells = <0>;
            bindings = <&kp MINUS>
                , <&kp RA(DOT)>;
        };
    };
};

/* Automatically generated behavior definitions */
/ {
    behaviors {


    };
};

/* Automatically generated combos definitions */


/* Automatically generated keymap */
/ {
    keymap {
        compatible = "zmk,keymap";


        layer_Base {
            bindings = <
              &kp ESC      &kp N1      &kp N2       &kp N3       &kp N4                                                                                                                                                &kp N7            &kp N8      &kp N9         &kp N0  &kp MINUS
              &kp ESC      &kp N1      &kp N2       &kp N3       &kp N4  &kp N5                                                                                                                           &kp N6       &kp N7            &kp N8      &kp N9         &kp N0  &kp MINUS
                &none       &kp Q       &kp W        &kp E        &kp R   &kp T                                                                                                                            &kp Y        &kp U             &kp I       &kp O          &kp P   &kp BSLH
              &kp ESC  &mt LGUI A  &mt LALT S  &mt LSHFT D  &mt LCTRL F   &kp G                                                                                                                            &kp H  &mt LCTRL J       &mt LSHFT K  &mt LALT L  &mt LGUI SEMI    &kp SQT
               &tog 7       &kp Z       &kp X        &kp C        &kp V   &kp B    &kp TAB  &mo_tog LAYER_Shortcut LAYER_Mouse  &lt 8 RET  &kp RET                  &mo 2                          &sl 6   &kp N        &kp M         &kp COMMA     &kp DOT      &kp GRAVE  &kp PG_UP
 &magic LAYER_Magic 0       &kp Z     &kp F14       &tog 7      &kp F22          &kp SPACE                               &mo 1    &kp F22  &kp F22  &lt_hold_pref 2 ENTER  &mt_hold_pref LSHFT BACKSPACE            &kp LC(A)  &kp LC(LA(HOME))    &kp LBKT      &kp GRAVE  &kp PG_DN
            >;
        };

        layer_Nav {
            bindings = <
 &trans    &kp F11         &kp F12         &kp F11          &kp F12                                                                                      &kp F11           &kp F12          &kp F11    &kp F12  &kp PSCRN
 &trans     &kp F1          &kp F2          &kp F3           &kp F4     &kp F5                                                                 &kp F6     &kp F7            &kp F8           &kp F9    &kp F10  &kp PSCRN
 &trans    &kp ESC        &kp HOME    &kp UP_ARROW          &kp END  &kp PG_UP                                                              &kp LC(C)  &kp LC(Z)           &kp INS            &none  &kp LC(V)  &kp PSCRN
 &trans     &trans  &kp LEFT_ARROW  &kp DOWN_ARROW  &kp RIGHT_ARROW  &kp PG_DN                                                            &kp LS(INS)  &kp LCTRL         &kp LSHFT         &kp LALT   &kp LGUI     &trans
 &trans  &kp K_APP    &kp LC(HOME)      &CEND_HOME      &kp LC(END)     &trans  &trans  &trans   &to 0  &kp ESC  &kp LG(LSHFT)  &kp LGUI       &trans    &kp TAB  &kp LC(LS(SEMI))  &kp LC(LA(DEL))     &trans     &trans
 &trans     &trans        &mkp MB4        &mkp MB4         &mkp MB5             &trans   &to 0   &to 0  &kp DEL        &kp ESC   &kp DEL                  &trans            &trans           &trans     &trans     &trans
            >;
        };

        layer_Symbol {
            bindings = <
 &trans      &trans      &trans      &trans         &trans                                                                                                &trans            &trans        &trans        &trans  &trans
 &trans  &kp LS(N1)  &kp LS(N2)  &kp LS(N3)     &kp LS(N4)     &kp LS(N5)                                                              &kp LS(N6)     &kp LS(N7)        &kp LS(N8)    &kp LS(N9)    &kp LS(N0)  &trans
 &trans      &trans     &kp SQT    &kp FSLH       &kp LBKT   &kp RA(LBKT)                                                           &kp RA(GRAVE)         &ARROW         &BACKTICK  &kp RA(RBKT)        &trans  &trans
 &trans    &kp BSLH  &kp RA(N7)  &kp RA(N9)     &kp LS(N9)      &kp MINUS                                                               &kp EQUAL     &kp LS(N0)        &kp RA(N0)    &kp RA(N8)  &kp LS(SEMI)  &trans
 &trans      &trans   &BACKTICK    &kp RBKT  &kp LS(MINUS)  &kp RA(COMMA)     &trans  &kp LSHFT  &kp LSHFT   &to 0  &trans  &trans    &kp RA(DOT)  &kp LS(EQUAL)  &kp LS(KP_COMMA)   &kp LS(DOT)        &trans  &trans
 &trans      &trans      &trans      &trans         &trans                 &kp LSHFT  &kp LSHFT  &kp LSHFT   &to 0   &to 0  &trans                        &trans            &trans        &trans        &trans  &trans
            >;
        };

        layer_Shortcut {
            bindings = <
     &trans      &trans        &trans        &trans         &trans                                                                               &trans       &trans  &trans         &trans  &trans
     &trans  &kp C_PREV    &kp C_PLAY    &kp C_NEXT   &kp C_VOL_DN  &kp C_VOL_UP                                                         &trans  &trans       &trans  &trans         &trans  &trans
     &trans  &kp LG(N6)    &kp LG(N5)        &trans     &kp LG(N7)    &kp LG(N4)                                                  &kp LS(LC(C))  &trans  &kp LS(INS)  &trans  &kp LS(LC(V))  &trans
     &trans  &kp LG(N1)    &kp LG(N2)    &kp LG(N3)     &kp LG(N4)    &kp LG(N5)                                                         &trans  &trans       &trans  &trans         &trans  &trans
 &kp LA(F4)      &trans    &kp LG(N3)    &kp LG(N2)     &kp LG(N3)    &kp LG(N1)  &trans   &to 0  &trans  &trans  &trans  &trans         &trans  &trans       &trans  &trans         &trans  &trans
 &kp LA(F4)      &trans  &kp LA(LEFT)  &kp LA(LEFT)  &kp LA(RIGHT)                &trans   &to 0  &trans  &trans  &trans  &trans                 &trans       &trans  &trans         &trans  &trans
            >;
        };

        layer_Mouse {
            bindings = <
     &trans      &trans          &trans          &trans           &trans                                                                                   &trans     &trans    &trans    &trans     &trans
     &trans  &kp C_PREV      &kp C_PLAY      &kp C_NEXT     &kp C_VOL_DN    &kp C_VOL_UP                                                        &trans     &trans     &trans    &trans    &trans  &kp PSCRN
     &trans      &trans          &trans    &mmv MOVE_UP        &mkp MCLK    &msc SCRL_UP                                                      &mkp MB5     &trans     &trans    &trans    &trans     &trans
     &trans      &trans  &mmv MOVE_LEFT  &mmv MOVE_DOWN  &mmv MOVE_RIGHT  &msc SCRL_DOWN                                                      &mkp MB4  &kp LCTRL  &kp LSHFT  &kp LALT  &kp LGUI     &trans
 &kp LA(F4)      &trans  &msc SCRL_LEFT          &trans  &msc SCRL_RIGHT          &trans     &mo 9     &to 0  &trans  &trans  &trans  &trans    &trans     &trans     &trans    &trans    &trans     &trans
 &kp LA(F4)      &trans        &mkp MB4        &mkp MB4         &mkp MB5                  &mkp MB1  &mkp MB2  &mo 10  &trans  &trans  &trans               &trans     &trans    &trans    &trans     &trans
            >;
        };

        layer_Magic {
            bindings = <
  &bt BT_CLR            &none            &none            &none            &none                                                                                  &none   &none   &none   &none  &bt BT_CLR_ALL
       &none            &bt_0            &bt_1            &bt_2            &bt_3            &none                                                         &none   &none   &none   &none   &none           &none
       &none  &rgb_ug RGB_SPI  &rgb_ug RGB_SAI  &rgb_ug RGB_HUI  &rgb_ug RGB_BRI  &rgb_ug RGB_TOG                                                         &none   &none   &none   &none   &none           &none
 &bootloader  &rgb_ug RGB_SPD  &rgb_ug RGB_SAD  &rgb_ug RGB_HUD  &rgb_ug RGB_BRD  &rgb_ug RGB_EFF                                                         &none   &none   &none   &none   &none     &bootloader
  &sys_reset            &none            &none            &none            &none            &none   &bt_2   &bt_3         &none   &none   &none   &none   &none   &none   &none   &none   &none      &sys_reset
       &none            &none            &none            &none            &none                    &bt_0   &bt_1  &out OUT_USB   &none   &none   &none           &none   &none   &none   &none           &none
            >;
        };

        layer_Num {
            bindings = <
 &trans       &trans       &trans        &trans        &trans                                                                                &trans        &trans       &trans       &trans  &trans
 &trans      &kp F11      &kp F12        &trans        &trans      &trans                                                      &trans        &trans        &trans       &trans       &trans  &trans
 &trans       &kp F1       &kp F2        &kp F3        &kp F4      &kp F5                                                      &kp F6        &kp F7        &kp F8       &kp F9      &kp F10  &trans
 &trans  &mt LGUI N1  &mt LALT N2  &mt LSHFT N3  &mt LCTRL N4      &kp N5                                                      &kp N6  &mt LCTRL N7  &mt LSHFT N8  &mt LALT N9  &mt LGUI N0  &trans
 &trans   &kp LS(N1)   &kp LS(N2)    &kp LS(N3)    &kp LS(N4)  &kp LS(N5)  &trans  &trans  &trans  &trans  &trans   &to 0  &kp LS(N6)    &kp LS(N7)    &kp LS(N8)   &kp LS(N9)   &kp LS(N0)  &trans
 &trans       &trans       &trans       &kp F11       &kp F12              &trans  &trans  &trans  &trans  &trans  &trans                    &trans        &trans       &trans       &trans  &trans
            >;
        };

        layer_Gaming {
            bindings = <
 &kp ESC  &kp F1   &kp F2  &kp F3   &kp F4                                                                          &kp F7     &kp F8   &kp F9   &kp F10  &kp F11
 &kp ESC  &kp N1   &kp N2  &kp N3   &kp N4  &kp N5                                                          &kp N6  &kp N7     &kp N8   &kp N9    &kp N0   &trans
 &kp ESC   &kp G    &kp Q   &kp W    &kp E   &kp R                                                           &kp Y   &kp U      &kp I    &kp O     &kp P   &trans
 &kp ESC  &kp N1    &kp A   &kp S    &kp D   &kp F                                                           &kp H   &kp J      &kp K    &kp L  &kp SEMI   &trans
   &to 0   &kp Z    &kp X   &kp C    &kp V   &kp B  &kp LCTRL      &sl 8  &kp F22   &to 0   &trans  &trans   &kp N   &kp M  &kp COMMA  &kp DOT  &kp FSLH   &trans
   &kp T   &kp H  &kp TAB   &to 0  &kp F22          &kp SPACE  &kp LSHFT  &kp TAB  &trans  &tog 11  &trans          &trans     &trans   &trans    &trans   &trans
            >;
        };

        layer_Mirror {
            bindings = <
 &trans  &kp F6  &kp F7     &kp F8    &kp F9                                                                     &kp F2  &kp F3  &kp F4  &kp F5  &kp F10
 &trans  &kp N6  &kp N7     &kp N8    &kp N9     &kp N0                                                  &kp N1  &kp N2  &kp N3  &kp N4  &kp N5   &trans
 &trans   &kp Y   &kp U      &kp I     &kp O      &kp P                                                   &kp Q   &kp W   &kp E   &kp R   &kp T   &trans
 &trans   &kp H   &kp J      &kp K     &kp L   &kp SEMI                                                   &kp A   &kp S   &kp D   &kp F   &kp G   &trans
 &trans   &kp N   &kp M  &kp COMMA   &kp DOT  &kp GRAVE  &trans   &none  &trans  &trans  &trans  &trans   &kp Z   &kp X   &kp C   &kp V   &kp B   &trans
 &trans   &kp N  &trans     &trans  &kp BSPC             &trans  &trans  &trans  &trans  &trans  &trans          &trans  &trans  &trans   &kp B   &trans
            >;
        };

        layer_Mouse_fast {
            bindings = <
 &trans  &trans  &trans  &trans  &trans                                                                  &trans  &trans  &trans  &trans  &trans
 &trans  &trans  &trans  &trans  &trans  &trans                                                  &trans  &trans  &trans  &trans  &trans  &trans
 &trans  &trans  &trans  &trans  &trans  &trans                                                  &trans  &trans  &trans  &trans  &trans  &trans
 &trans  &trans  &trans  &trans  &trans  &trans                                                  &trans  &trans  &trans  &trans  &trans  &trans
 &trans  &trans  &trans  &trans  &trans  &trans  &trans  &trans  &trans  &trans  &trans  &trans  &trans  &trans  &trans  &trans  &trans  &trans
 &trans  &trans  &trans  &trans  &trans          &trans  &trans  &trans  &trans  &trans  &trans          &trans  &trans  &trans  &trans  &trans
            >;
        };

        layer_Mouse_warp {
            bindings = <
 &trans  &trans  &trans  &trans  &trans                                                                  &trans  &trans  &trans  &trans  &trans
 &trans  &trans  &trans  &trans  &trans  &trans                                                  &trans  &trans  &trans  &trans  &trans  &trans
 &trans  &trans  &trans  &trans  &trans  &trans                                                  &trans  &trans  &trans  &trans  &trans  &trans
 &trans  &trans  &trans  &trans  &trans  &trans                                                  &trans  &trans  &trans  &trans  &trans  &trans
 &trans  &trans  &trans  &trans  &trans  &trans  &trans  &trans  &trans  &trans  &trans  &trans  &trans  &trans  &trans  &trans  &trans  &trans
 &trans  &trans  &trans  &trans  &trans          &trans  &trans  &trans  &trans  &trans  &trans          &trans  &trans  &trans  &trans  &trans
            >;
        };

        layer_Nav_enter {
            bindings = <
 &trans    &kp F11         &kp F12         &kp F11          &kp F12                                                                                            &kp F11           &kp F12          &kp F11    &kp F12  &kp PSCRN
 &trans     &kp F1          &kp F2          &kp F3           &kp F4     &kp F5                                                                       &kp F6     &kp F7            &kp F8           &kp F9    &kp F10  &kp PSCRN
 &trans    &kp ESC        &kp HOME    &kp UP_ARROW          &kp END  &kp PG_UP                                                                    &kp LC(C)  &kp LC(Z)           &kp INS            &none  &kp LC(V)  &kp PSCRN
 &trans      &kp Q  &kp LEFT_ARROW  &kp DOWN_ARROW  &kp RIGHT_ARROW  &kp PG_DN                                                                  &kp LS(INS)  &kp LCTRL         &kp LSHFT         &kp LALT   &kp LGUI     &trans
 &trans  &kp K_APP    &kp LC(HOME)      &CEND_HOME      &kp LC(END)     &trans  &kp LCTRL     &trans   &trans    &to 0  &kp LG(LSHFT)  &tog 11       &trans    &kp TAB  &kp LC(LS(SEMI))  &kp LC(LA(DEL))     &trans     &trans
 &trans     &trans          &trans           &to 0          &kp F12               &kp RET  &kp SPACE  &kp F22  &kp F22        &tog 11  &kp DEL                  &trans            &trans           &trans     &trans     &trans
            >;
        };

    };
};
